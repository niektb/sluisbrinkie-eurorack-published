// Grains V2.1
// smooth CV pitch
// 02-06-2015 finetune for PCB V2 added on pin A3
//
// based on the Auduino code by Peter Knight, revised and finetuned by Ginkosynthese for use with cv inputs.
//
// inputs
// Analog in 0: Grain repetition frequency
// Analog in 1: Grain 1 pitch
// Analog in 2: Grain 2 pitch
// output
// Digital 11: Audio out (PWM)

// Based on Grains V2.1 but ported to 32U4 (Toepler platform)

#include "PinDef.h"

#include <avr/io.h>
#include <avr/interrupt.h>
#include <avr/pgmspace.h>

uint16_t syncPhaseAcc;
uint16_t syncPhaseInc;
uint16_t grainPhaseAcc;
uint16_t grainPhaseInc;
uint16_t grainAmp;
uint8_t grainDecay;
uint16_t grain2PhaseAcc;
uint16_t grain2PhaseInc;
uint16_t grain2Amp;
uint8_t grain2Decay;

// Map Analogue channels
#define SYNC_CONTROL CV1_PIN
#define SYNC_OFFSET CV4_PIN
#define GRAIN_FREQ_CONTROL CV2_PIN
#define GRAIN2_FREQ_CONTROL CV3_PIN

// Changing these will also requires rewriting audioOn()
//    Output is on pin 11
#define PWM_PIN 9
#define PWM_VALUE OCR1A
#define LED_PIN 13
#define LED_PORT PORTC
#define LED_BIT 7
#define PWM_INTERRUPT TIMER1_OVF_vect

const uint16_t freqTable[] PROGMEM = {
  69, 69, 69, 69, 70, 70, 70, 70, 70, 71, 71, 71, 71, 72, 72, 72, 72, 73, 73, 73, 73,
  74, 74, 74, 74, 75, 75, 75, 75, 76, 76, 76, 76, 77, 77, 77, 77, 78, 78, 78, 78, 79,
  79, 79, 79, 80, 80, 80, 81, 81, 81, 81, 82, 82, 82, 82, 83, 83, 83, 84, 84, 84, 84,
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  2006, 2012, 2019, 2026, 2033, 2040, 2046, 2053, 2060, 2067, 2074, 2081, 2088, 2095, 2102, 2109
};
uint16_t mapFreq(uint16_t input) {
  return pgm_read_word_near(freqTable + input);
}

//port
void audioOn() {
  // Set up PWM to 31.25kHz, phase accurate
  TCCR1A = _BV(COM1A1) | _BV(WGM10);
  TCCR1B = _BV(CS10);
  TIMSK1 = _BV(TOIE1);
}


void setup() {
  pinMode(PWM_PIN, OUTPUT);
  audioOn();
  pinMode(LED_PIN, OUTPUT);
}

void loop() {
  int pwmv = analogRead(SYNC_CONTROL) + (analogRead(SYNC_OFFSET) / 5 - 205);
  if (pwmv > 1023) pwmv = 1023;
  if (pwmv < 0) pwmv = 0;
  syncPhaseInc = mapFreq(pwmv);
  grainPhaseInc = mapFreq(analogRead(GRAIN_FREQ_CONTROL)) * 2;
  grainDecay = 10 / 8;
  grain2PhaseInc = mapFreq(analogRead(GRAIN2_FREQ_CONTROL)) * 4;
  grain2Decay = 10 / 4;
}

ISR(PWM_INTERRUPT) {
  uint8_t value;
  uint16_t output;

  syncPhaseAcc += syncPhaseInc;
  if (syncPhaseAcc < syncPhaseInc) {
    // Time to start the next grain
    grainPhaseAcc = 0;
    grainAmp = 0x7fff;
    grain2PhaseAcc = 0;
    grain2Amp = 0x7fff;
    LED_PORT ^= 1 << LED_BIT;  // Faster than using digitalWrite
  }

  grainPhaseAcc += grainPhaseInc;
  grain2PhaseAcc += grain2PhaseInc;

  value = (grainPhaseAcc >> 7) & 0xff;
  if (grainPhaseAcc & 0x8000) value = ~value;
  output = value * (grainAmp >> 8);

  value = (grain2PhaseAcc >> 7) & 0xff;
  if (grain2PhaseAcc & 0x8000) value = ~value;
  output += value * (grain2Amp >> 8);

  grainAmp -= (grainAmp >> 8) * grainDecay;
  grain2Amp -= (grain2Amp >> 8) * grain2Decay;

  output >>= 9;
  if (output > 255) output = 255;

  PWM_VALUE = output;
}